## boards/shields/patkb/Kconfig.defconfig
```kconfig
if SHIELD_PATKB_LEFT

config ZMK_KEYBOARD_NAME
    default "patkb"

config BT_DEVICE_NAME
    default "patkb"

config ZMK_SPLIT_ROLE_CENTRAL
    default y

endif

if SHIELD_PATKB_LEFT || SHIELD_PATKB_RIGHT

config ZMK_SPLIT
    default y

endif
```

## boards/shields/patkb/Kconfig.shield
```kconfig
config SHIELD_PATKB_LEFT
  def_bool $(shields_list_contains,patkb_left)

config SHIELD_PATKB_RIGHT
  def_bool $(shields_list_contains,patkb_right)
```
